/*
  This code initializes an OLED display (SSD1306) using the Adafruit SSD1306 library, 
  and displays various text, numbers, and scroll animations on the screen.

  Board: ESP32 Development Board
  Component: OLED (SSD1306)
  Library: https://github.com/adafruit/Adafruit_SSD1306 (Adafruit SSD1306 by Adafruit)  
           https://github.com/adafruit/Adafruit-GFX-Library (Adafruit GFX Library by Adafruit) 
*/


#include <SPI.h>
#include <Wire.h>
#include <Adafruit_GFX.h>
#include <Adafruit_SSD1306.h>
#include <chevron_arrows.h>

#define SCREEN_WIDTH 128  // OLED display width, in pixels
#define SCREEN_HEIGHT 64  // OLED display height, in pixels

// Declaration for SSD1306 display connected using I2C
#define OLED_RESET -1  // Reset pin # (or -1 if sharing Arduino reset pin)
#define SCREEN_ADDRESS 0x3C
Adafruit_SSD1306 display(SCREEN_WIDTH, SCREEN_HEIGHT, &Wire, OLED_RESET);

#define JOY_X A0
#define JOY_Y A1
#define JOYB_X A2
#define JOYB_Y A3

//Bitmap data
static const unsigned char PROGMEM sunfounderIcon[] = {
	0x00, 0x00, 0x00, 0x00, 0x00, 0x00, 0x00, 0x00, 0x00, 0x00, 0x00, 0x00, 0x00, 0x00, 0x00, 0x00, 
	0x00, 0x00, 0x00, 0x00, 0x00, 0x00, 0x00, 0x00, 0x00, 0x00, 0x00, 0x00, 0x00, 0x00, 0x00, 0x00, 
	0x00, 0x00, 0x00, 0x00, 0x00, 0x00, 0x00, 0x00, 0x00, 0x00, 0x00, 0x00, 0x00, 0x00, 0x00, 0x00, 
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	0x00, 0x00, 0x00, 0x00, 0x00, 0x00, 0x00, 0x00, 0x00, 0x00, 0x00, 0x00, 0x00, 0x00, 0x00, 0x00
};

void showArrow(const unsigned char* arrowBitmap) {
  display.clearDisplay();
  display.drawBitmap(0, 0, arrowBitmap, 128, 64, WHITE);
  display.display();
}

void setup() {
  Serial.begin(115200);

  // initialize the OLED object
  if (!display.begin(SSD1306_SWITCHCAPVCC, SCREEN_ADDRESS)) {
    Serial.println(F("SSD1306 allocation failed"));
    for (;;)
      ;
  }
}

int primary_dir = 0;
  int secondary_dir = 0;

void loop() {
	Serial.println("X: " + String(analogRead(JOY_X)) + ", Y: " + String(analogRead(JOY_Y)));

	int x = analogRead(JOY_X);
	int y = analogRead(JOY_Y);

	int xb = analogRead(JOYB_X);
	int yb = analogRead(JOYB_Y);

	// find primary arrow
	if (x < 1000) {
		if (y < 1000) {
			primary_dir = 4;
		} else if (y > 2500) {
			primary_dir = 6;
		} else {
			primary_dir = 2;
		}
	} else if (x > 2500) {
		if (y < 1000) {
			primary_dir = 5;
		} else if (y > 2500) {
			primary_dir = 7;
		} else {
			primary_dir = 3;
		}
	} else {
		if (y < 1000) {
			primary_dir = 0;
		} else if (y > 2500) {
			primary_dir = 1;
		}
	}

	// find secondary arrow
	if (xb < 1000) {
		if (yb < 1000) {
			secondary_dir = 4;
		} else if (yb > 2500) {
			secondary_dir = 6;
		} else {
			secondary_dir = 2;
		}
	} else if (xb > 2500) {
		if (yb < 1000) {
			secondary_dir = 5;
		} else if (yb > 2500) {
			secondary_dir = 7;
		} else {
			secondary_dir = 3;
		}
	} else {
		if (yb < 1000) {
			secondary_dir = 0;
		} else if (yb > 2500) {
			secondary_dir = 1;
		}
	}

	showArrow(ARROW_BITMAP(primary_dir, secondary_dir));
}
